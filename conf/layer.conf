## conf/layer.conf
```bitbake
# We have a conf and classes directory, add to BBPATH
BBPATH .= ":${LAYERDIR}"

# We have recipes-* directories, add to BBFILES
BBFILES += "${LAYERDIR}/recipes-*/*/*.bb \
            ${LAYERDIR}/recipes-*/*/*.bbappend"

BBFILE_COLLECTIONS += "meta-sysele-nxp-5.15.71"
BBFILE_PATTERN_meta-sysele-nxp-5.15.71 = "^${LAYERDIR}/"
BBFILE_PRIORITY_meta-sysele-nxp-5.15.71 = "9"

LAYERDEPENDS_meta-sysele-nxp-5.15.71 = "core"
LAYERSERIES_COMPAT_meta-sysele-nxp-5.15.71 = "kirkstone"
```

## conf/machine/astrial-4gb-imx8mp.conf
```bitbake
#@TYPE: Machine
#@NAME: System Electronics Astrial i.MX 8M Plus with 4GB LPDDR4
#@SOC: i.MX8MP
#@DESCRIPTION: Machine configuration for System Electronics Astrial i.MX 8M Plus board with 4GB LPDDR4
#@MAINTAINER: System Eletronics <info@systemelectronics.com>

require conf/machine/include/astrial-imx8mp.inc

# u-boot configuration
UBOOT_CONFIG_BASENAME = "imx8mp_astrial_4gb"
```

## conf/machine/astrial-imx8mp.conf
```bitbake
#@TYPE: Machine
#@NAME: System Electronics Astrial i.MX 8M Plus with LPDDR4
#@SOC: i.MX8MP
#@DESCRIPTION: Machine configuration for System Electronics Astrial i.MX 8M Plus board with LPDDR4
#@MAINTAINER: Koan software <info@koansoftware.com>

require conf/machine/include/imx8mp-evk.inc

# kernel device tree
KERNEL_DEVICETREE = " \
    system-electronics/${KERNEL_DEVICETREE_BASENAME}.dtb \
    system-electronics/${KERNEL_DEVICETREE_BASENAME}-disable-all.dtb \
    system-electronics/${KERNEL_DEVICETREE_BASENAME}-enable-all.dtb \
    system-electronics/${KERNEL_DEVICETREE_BASENAME}-flexcan2.dtb \
    system-electronics/${KERNEL_DEVICETREE_BASENAME}-sdhc1.dtb \
    system-electronics/${KERNEL_DEVICETREE_BASENAME}-spi2.dtb \
    system-electronics/${KERNEL_DEVICETREE_BASENAME}-uart3.dtb \
    system-electronics/${KERNEL_DEVICETREE_BASENAME}-dsi-rpi.dtb \
"
KERNEL_DEVICETREE_BASENAME = "imx8mp-astrial"

# u-boot configuration
UBOOT_CONFIG_BASENAME = "imx8mp_astrial"

# Set DDR FIRMWARE
DDR_FIRMWARE_VERSION = "202006"
DDR_FIRMWARE_NAME = " \
	lpddr4_pmu_train_1d_dmem_${DDR_FIRMWARE_VERSION}.bin \
	lpddr4_pmu_train_1d_imem_${DDR_FIRMWARE_VERSION}.bin \
	lpddr4_pmu_train_2d_dmem_${DDR_FIRMWARE_VERSION}.bin \
	lpddr4_pmu_train_2d_imem_${DDR_FIRMWARE_VERSION}.bin \
"

# imx-boot image target used by imx-mkimage
IMXBOOT_TARGETS_BASENAME = "flash_evk"

# Mainline BSP doesn't support LPDDR4 so it must be set to nxp.
# Also this machine isn't supported by u-boot-fslc but imx8mn-evk.inc already
# set the bootloader to u-boot-imx instead when NXP BSP is used.
IMX_DEFAULT_BSP = "nxp"

# we need to change the default serial for TF-A
ATF_BOOT_UART_BASE = "0x30860000"
```
